## config/west.yml
```yaml
manifest:
  remotes:
    - name: zmkfirmware
      url-base: https://github.com/zmkfirmware
    - name: mechwild
      url-base: https://github.com/mechwild
    - name: lesshonor
      url-base: https://github.com/lesshonor
  projects:
    - name: zmk
      remote: zmkfirmware
      revision: main
      import: app/west.yml
    - name: mechwild-zmk-keyboards # Add the name of the repository as a project.
      remote: lesshonor            # This has to match the name for the user you put in the "remote" earlier.
      revision: main   
  self:
    path: config
```
